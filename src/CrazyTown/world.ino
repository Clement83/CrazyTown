
//store the different sprites in PROGMEM to save RAM

//sprite 0
const byte Eau[] PROGMEM = {16,16,0x0,0x0,0x0,0x0,0x0,0x2,0x8,0x5,0x14,0x0,0x0,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0x0,};
//sprite 1
const byte Fleure[] PROGMEM = {16,16,0x0,0x0,0x50,0x0,0x20,0x28,0x50,0x10,0x0,0x28,0x0,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0x0,};
//sprite 2
const byte Foret[] PROGMEM = {16,16,0x0,0x0,0x10,0x0,0x6D,0x0,0x54,0x8,0xAA,0x14,0x54,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0x0,};
//sprite 3
const byte Pavillon[] PROGMEM = {16,16,0x0,0x0,0x7F,0xFE,0x6B,0x56,0x57,0xAA,0x7F,0xFE,0x6B,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0x0,};
//sprite 4
const byte RoofTop[] PROGMEM = {16,16,0x0,0x0,0x7F,0xFE,0x60,0x6,0x5F,0xFA,0x50,0xA,0x52,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0x0,};
//sprite 5
const byte Usine[] PROGMEM = {16,16,0x0,0x0,0x38,0x0,0x7D,0xFE,0x7D,0x2,0x7D,0x2,0x39,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0x0,};
//sprite 6
const byte Usine2[] PROGMEM = {16,16,0x0,0x20,0x0,0x50,0x38,0x20,0x47,0xFE,0x55,0x2,0x44,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0x0,};



const byte * GetSpriteById(byte idSprite)
{
  switch(idSprite)
  {
    case 0 :
    return Eau;
    break;
    case 1 :
    return Fleure;
    break;
    case 2 :
    return Foret;
    break;
    case 3 :
    return Pavillon;
    break;
    case 4 :
    return RoofTop;
    break;
    case 5 :
    return Usine2;
    break;
    case 6 :
    return Usine;
    break;
  }
}

#define NB_ZONE 8
//x1,y1, x2 ,y2, tuile
const byte Zones[NB_ZONE*5] PROGMEM = 
{
  0,0,127,31,3,
  0,32,32,62,0,
  47,94,86,116,0,
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  47,94,127,127,4,
};





#define WORLD_W 128
#define WORLD_H 128
const byte world[(WORLD_W/8)*WORLD_H] PROGMEM = {
B11111111,B11111111,B11111111,B11111111,B11111111,B11111111,B11111111,B11111111,B11111111,B11111111,B11111111,B11111111,B11111111,B11111111,B11111111,B11111111,
B10000000,B11111111,B11111111,B11111111,B10000000,B00000000,B01111111,B11111111,B11100000,B00000000,B00000000,B00000111,B11100000,B11111111,B11111111,B11111111,
B10000000,B00000000,B00000000,B00000000,B00000000,B00000000,B00000000,B00000000,B00000000,B01111011,B11011101,B11100111,B11101110,B00000000,B00000000,B11111111,
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B11111111,B11111111,B11111111,B11111111,B11111111,B11111111,B11111111,B11111111,B11111111,B11111111,B11111111,B11111111,B11111111,B11111111,B11111111,B11111111,
};



byte getTile(byte x, byte y){
  //Serial.print(y);  Serial.print(" <= y | x => "); Serial.print(x);Serial.print(" || ");
  //le decalage dépend de la position du joueur je divise x/8 car j'ai 8 bit dans un byte. puis je décale du nombre de bit util pour ne garder que le premier
  return (pgm_read_byte(world + (y*16) + x/8) >> (7-((x%8)))& B00000001);
}

void drawWorld(){
   for(byte y = max(0, (camera_y)/16); y < min(WORLD_W, (camera_y+LCDHEIGHT)/16+1); y++){
    for(byte x = max(0, (camera_x)/16); x < min(WORLD_H, (camera_x+LCDWIDTH)/16+1); x++){
      byte spriteID = getTile(x,y);
      if(spriteID == 0)
        continue;
        
        byte numSprite = 2;
       //Verrification des zone de sprite
        for(byte i=0;i<NB_ZONE;i++)
        {
          byte decalage = 5*i;
          byte x1 = pgm_read_byte(Zones + decalage);
          byte y1 = pgm_read_byte(Zones +decalage+1);
          byte x2 = pgm_read_byte(Zones+decalage+2);
          byte y2 = pgm_read_byte(Zones+decalage+3);
          
          if(gb.collidePointRect(x,y,x1,y1,x2-x1,y2-y1))
          {
            numSprite = pgm_read_byte(Zones+decalage+4);
            break;
          }
        }
      //coordinates on the screen depending on the camera position
      int x_screen = x*16 - camera_x;
      int y_screen = y*16 - camera_y;
      gb.display.drawBitmap(x_screen, y_screen, GetSpriteById(numSprite));
    }
  }
  
 
  //Test map 
 /* for(byte y=0;y<128;y++)
    {
        for(byte x=0;x<128;x++)
        {
            Serial.print(getTile(x,y));
        }
          Serial.println("");
    }
  drawTitleScreen();*/
}

void drawMap(){
  /*gb.display.fillRect(0,0,18,18);
  gb.display.setColor(WHITE);
  for(byte y = 0; y < 64; y++){
    for(byte x = 0; x < 64; x++){
      char tile_x = x + player.x/64 - 8;
      char tile_y = y + player.y/64 - 8;
      if(tile_x < 0 || tile_x > WORLD_W || tile_y < 0 || tile_y > WORLD_H)
        continue;
      if(getTile(x + player.x, y + player.y) == 0)
        gb.display.drawPixel(x+1, y+1);
    }
  }
  gb.display.setColor(BLACK);
  gb.display.drawPixel(9,9);*/
}



